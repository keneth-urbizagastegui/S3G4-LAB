* S9: immutable S7b included verbatim; only filter/amp/ADC timing changed.
.include "../../CH1_entrada/comun/ch1_comun_s7b.inc"
* Pin order is symbolic, not SOIC package pin numbers.
.subckt LM6172_W IP IM VP VN OUT
XCORE IP IM VP VN OUT LM6172/NS
.ends LM6172_W
.subckt AMP_S9_A IP IM VP VN OUT
XA IP IM VP VN OUT AD8038
.ends AMP_S9_A
.subckt AMP_S9_B IP IM VP VN OUT
XB IP IM VP VN OUT LM6172_W
.ends AMP_S9_B
* AMP_S9 is bound by the deck generator from AMP_S9_SELECT (0=A,1=B).
* Exactly one manufacturer instance, never two inactive loaded amplifiers.
.subckt SK_S9 IN OUT VP VN IP IM params: RA=1k RB=1k CF=100p CG=100p VOS=0 AMP=0
R1 IN MID {RA}
R2 MID PLUS {RB}
C1 MID OUT {CF}
C2 PLUS 0 {CG}
CPCB PLUS 0 {CPCB_S7}
VIP PLUS IP 0
VOS IP IPR {VOS}
VIM OUT IM 0
VCCP VP VPP 0
VCCN VN VNN 0
XAMP IPR IM VPP VNN OUT AMP_S9 KIND={AMP}
.ends SK_S9
.subckt CHANNEL_S9 BNC PIN VP VN VDDA VREF DAC params: POS=1 CODE=0 CPL=0 VO101=0 VOA=0 VOB=0 VOFA=0 VOFB=0 VO836=0 AMP=0 F1=2.49k F2=1.10k
XFE BNC RAWIN VP VN M TAP RSM X1 EQ SEL B T2 FRONT_S7B POS={POS} CPL={CPL}
VI101 RAWIN BI 0
VOS101 BI BIR {VO101}
VIM101 BO U101M 0
VIP101 VP VP101 0
VIN101 VN VN101 0
X101 BIR U101M BO_DRIVE VP101 VN101 OPA810
VOUT101 BO_DRIVE BO 0
XLAD BO Y1 Y2 Y3 Y4 Y5 LADDER_S3
RVCHECK Y7 0 {R_VCHECK_S7}
XMUX BO Y1 Y2 Y3 Y4 Y5 0 Y7 COMMON A0 A1 A2 MVP MVN MUX_S7B
VMUXP VP MVP 0
VMUXN VN MVN 0
BA0 A0 0 V=V(VP)*mod(CODE,2)
BA1 A1 0 V=V(VP)*mod(floor(CODE/2),2)
BA2 A2 0 V=V(VP)*floor(CODE/4)
CPCB COMMON 0 {C_COMMON_S7}
VIA COMMON SERA 0
VIB OA SERB 0
XPROTA SERA IPA IMA PROTECT_BAV99 R_SER={R_SER_S7}
XPROTB SERB IPB IMB PROTECT_BAV99 R_SER={R_SER_S7}
VOSA IPA IPAR {VOA}
VOSB IPB IPBR {VOB}
VIMA MA IMA 0
VIMB MB IMB 0
VIPA VP VPA 0
VINA VN VNA 0
VIPB VP VPB 0
VINB VN VNB 0
X103A IPAR IMA VPA VNA OA AMP_S9 KIND={AMP}
X103B IPBR IMB VPB VNB OUT AMP_S9 KIND={AMP}
RFA OA MA {RF1}
RGA MA 0 {RG1}
CMA MA 0 {C_GAIN_S7}
RFB OUT MB {RF2}
RGB MB 0 {RG2}
CMB MB 0 {C_GAIN_S7}
X105A OUT OA105 VP VN IPA105 IMA105 SK_S9 RA={F1} RB={F1} CF={CFILT1_S7} CG={CGILT1_S7} VOS={VOFA} AMP={AMP}
X105B OA105 FILTEROUT VP VN IPB105 IMB105 SK_S9 RA={F2} RB={F2} CF={CFILT2_S7} CG={CGILT2_S7} VOS={VOFB} AMP={AMP}
RT VREF VM {RT_MID}
RB VM 0 {RB_MID}
CMID VM 0 {C_MID_S7}
RIN FILTEROUT SUM {R_IN_S4}
ROFF DAC SUM {R_OFF_S4}
RF O SUM {R_F_S4}
CF O SUM {C_FB_S7}
CSUM SUM 0 {C_SUM_S4}
VIP VM IP 0
VOS836 IP IPR {VO836}
VIM SUM IM 0
VCC VDDA VCC 0
XAMP IPR IM O VCC 0 VDDA OPA836_S4_ESD
RADC O PIN {R_ADC_S4}
CADC PIN 0 {C_ADC_S4}
CPAD PIN 0 {CPAD_S6}
.ends CHANNEL_S9
